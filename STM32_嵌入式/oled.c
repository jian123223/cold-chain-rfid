#include "oled.h"
#include <string.h>

// 8*8 ASCII小字库（0x20~0x7F）
const uint8_t OLED_F8x8[] = {
0x00,0x00,0x00,0x00,0x00,0x00,0x00,0x00,// 空格 0x20
0x00,0x00,0x5F,0x00,0x00,0x00,0x00,0x00,// !
0x00,0x03,0x00,0x03,0x00,0x00,0x00,0x00,// "
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0x08,0x04,0x08,0x04,0x00,0x00,0x00,0x00,// ~
};

// 8行小字日志缓存
char oled_small_buf[OLED_LINE_NUM_SMALL][OLED_LINE_LEN_SMALL + 1];

// 16x16中文字库（列行式，先上半页再下半页）
const uint8_t OLED_F16x16[][32] = {
{0x00,0x02,0x82,0x82,0x82,0x82,0x82,0xFE,0x82,0x82,0x82,0x82,0x82,0x02,0x00,0x00,
0x40,0x40,0x40,0x40,0x40,0x40,0x40,0x7F,0x40,0x40,0x40,0x40,0x40,0x40,0x40,0x00},
{0x80,0x84,0x44,0x44,0x24,0x14,0x0C,0xFF,0x0C,0x14,0x24,0x44,0x44,0x84,0x80,0x00,
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0x00,0xFF,0x08,0x10,0x88,0x47,0x20,0x18,0x07,0x00,0x07,0x18,0x20,0x40,0x80,0x00},
};

// I2C底层静态函数
static void OLED_I2C_Start(void)
{
	OLED_W_SDA(1);
	OLED_W_SCL(1);
	OLED_W_SDA(0);
	OLED_W_SCL(0);
}
static void OLED_I2C_Stop(void)
{
	OLED_W_SDA(0);
	OLED_W_SCL(1);
	OLED_W_SDA(1);
}
static void OLED_I2C_SendByte(uint8_t Byte)
{
	uint8_t i;
	for (i = 0; i < 8; i++)
	{
		OLED_W_SDA(!!(Byte & (0x80 >> i)));
		OLED_W_SCL(1);
		OLED_W_SCL(0);
	}
	OLED_W_SCL(1);
	OLED_W_SCL(0);
}
static void OLED_WriteCmd(uint8_t Command)
{
	OLED_I2C_Start();
	OLED_I2C_SendByte(0x78);
	OLED_I2C_SendByte(0x00);
	OLED_I2C_SendByte(Command);
	OLED_I2C_Stop();
}
static void OLED_WriteData(uint8_t Data)
{
	OLED_I2C_Start();
	OLED_I2C_SendByte(0x78);
	OLED_I2C_SendByte(0x40);
	OLED_I2C_SendByte(Data);
	OLED_I2C_Stop();
}

// I2C引脚初始化
void OLED_I2C_Init(void)
{
	OLED_W_SCL(1);
	OLED_W_SDA(1);
}

// 光标设置 Y=0~7(8行), X=0~15(16字符)
void OLED_SetCursor(uint8_t Y, uint8_t X)
{
	OLED_WriteCmd(0xB0 | Y);
	OLED_WriteCmd(0x10 | ((X & 0xF0) >> 4));
	OLED_WriteCmd(0x00 | (X & 0x0F));
}

// 全屏清屏
void OLED_Clear(void)
{
	uint8_t y, x;
	for(y = 0; y < 8; y++)
	{
		OLED_SetCursor(y, 0);
		for(x = 0; x < 128; x++)
			OLED_WriteData(0x00);
	}
}

// ========== 8×8小字显示函数 ==========
// ========== 8×8小字显示函数 ==========
// ========== 8×8小字显示函数 ==========
void OLED_ShowChar8(uint8_t Y, uint8_t X, char Char)
{
	uint16_t idx = Char - ' ';
	if(idx > 95) idx = 0;
	OLED_SetCursor(Y, X << 3);
	uint8_t i;
	for(i = 0; i < 8; i++)
		OLED_WriteData(OLED_F8x8[idx * 8 + i]);
}

void OLED_ShowString8(uint8_t Y, uint8_t X, char *String)
{
	uint8_t i;
	for(i = 0; String[i] != '\0'; i++)
	{
		if(X + i >= OLED_LINE_LEN_SMALL) break;
		OLED_ShowChar8(Y, X + i, String[i]);
	}
}

// 8行日志滚动
void OLED_AppendSmallLog(char *str)
{
	uint8_t i;
	for(i = 0; i < OLED_LINE_NUM_SMALL - 1; i++)
		strcpy(oled_small_buf[i], oled_small_buf[i+1]);
	strncpy(oled_small_buf[OLED_LINE_NUM_SMALL - 1], str, OLED_LINE_LEN_SMALL);
	oled_small_buf[OLED_LINE_NUM_SMALL - 1][OLED_LINE_LEN_SMALL] = '\0';
}

// OLED初始化命令
void OLED_Init(void)
{
	uint32_t i,j;
	// 上电等待，解决OLED无显示
	for(i=0;i<10000;i++) for(j=0;j<30;j++);
	OLED_I2C_Init();
	OLED_WriteCmd(0xAE);
	OLED_WriteCmd(0xD5);OLED_WriteCmd(0x80);
	OLED_WriteCmd(0xA8);OLED_WriteCmd(0x3F);
	OLED_WriteCmd(0xD3);OLED_WriteCmd(0x00);
	OLED_WriteCmd(0x40);
	OLED_WriteCmd(0xA1);
	OLED_WriteCmd(0xC8);
	OLED_WriteCmd(0xDA);OLED_WriteCmd(0x12);
	OLED_WriteCmd(0x81);OLED_WriteCmd(0xCF);
	OLED_WriteCmd(0xD9);OLED_WriteCmd(0xF1);
	OLED_WriteCmd(0xDB);OLED_WriteCmd(0x30);
	OLED_WriteCmd(0xA4);
	OLED_WriteCmd(0xA6);
	OLED_WriteCmd(0x8D);OLED_WriteCmd(0x14);
	OLED_WriteCmd(0xAF);
	OLED_Clear();
}

void OLED_ShowChinese16(uint8_t page, uint8_t col, uint8_t idx)
{
	uint8_t i;
	OLED_SetCursor(page, col);
	for(i = 0; i < 16; i++)
		OLED_WriteData(OLED_F16x16[idx][i]);
	OLED_SetCursor(page + 1, col);
	for(i = 0; i < 16; i++)
		OLED_WriteData(OLED_F16x16[idx][16 + i]);
}

void OLED_ClearLine8(uint8_t Y)
{
	OLED_SetCursor(Y, 0);
	uint8_t x;
	for(x = 0; x < 128; x++)
		OLED_WriteData(0x00);
}
